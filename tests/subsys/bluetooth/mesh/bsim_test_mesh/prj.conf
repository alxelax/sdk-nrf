## CMakeLists.txt
```
# SPDX-License-Identifier: Apache-2.0

cmake_minimum_required(VERSION 3.13.1)

if (NOT DEFINED ENV{BSIM_COMPONENTS_PATH})
	message(FATAL_ERROR "This test requires the BabbleSim simulator. Please set\
 the  environment variable BSIM_COMPONENTS_PATH to point to its components \
 folder. More information can be found in\
 https://babblesim.github.io/folder_structure_and_env.html")
endif()

find_package(Zephyr REQUIRED HINTS $ENV{ZEPHYR_BASE})
project(bsim_test_mesh)

target_sources(app PRIVATE
	src/main.c
	src/mesh_test.c
	src/test_scheduler_model.c
)

zephyr_include_directories(
  $ENV{BSIM_COMPONENTS_PATH}/libUtilv1/src/
  $ENV{BSIM_COMPONENTS_PATH}/libPhyComv1/src/
)
```

## prj.conf
```kconfig
CONFIG_LOG_MODE_IMMEDIATE=y
CONFIG_SETTINGS=y
CONFIG_FILE_SYSTEM=y
CONFIG_FAT_FILESYSTEM_ELM=y
CONFIG_DISK_ACCESS=y
CONFIG_DISK_DRIVER_RAM=y
CONFIG_DISK_RAM_VOLUME_SIZE=80
CONFIG_POSIX_FS=y
CONFIG_SETTINGS_FS=y
CONFIG_SETTINGS_FS_DIR="/RAM:/settings"
CONFIG_SETTINGS_FS_FILE="/RAM:/settings/data"

# Bluetooth configuration
CONFIG_BT=y
CONFIG_BT_PRIVACY=n
CONFIG_BT_COMPANY_ID=0x0059
CONFIG_BT_DEVICE_NAME="Mesh test"
CONFIG_BT_LL_SW_SPLIT=y
CONFIG_BT_OBSERVER=y
CONFIG_BT_BROADCASTER=y
CONFIG_BT_TINYCRYPT_ECC=y
CONFIG_BT_DEBUG_LOG=y

# Disable unused Bluetooth features
CONFIG_BT_CTLR_DUP_FILTER_LEN=0
CONFIG_BT_CTLR_PRIVACY=n

# Bluetooth mesh configuration
CONFIG_BT_MESH=y
CONFIG_BT_MESH_RELAY=y
CONFIG_BT_MESH_ADV_BUF_COUNT=32
CONFIG_BT_MESH_TX_SEG_MAX=32
CONFIG_BT_MESH_RX_SEG_MAX=32
CONFIG_BT_MESH_TX_SEG_MSG_COUNT=10
CONFIG_BT_MESH_RX_SEG_MSG_COUNT=10
CONFIG_BT_MESH_CFG_CLI=y
CONFIG_BT_MESH_MODEL_GROUP_COUNT=3
CONFIG_BT_MESH_LOW_POWER=y
CONFIG_BT_MESH_LPN_AUTO=n
CONFIG_BT_MESH_FRIEND=y
CONFIG_BT_MESH_FRIEND_ENABLED=n
CONFIG_BT_MESH_FRIEND_LPN_COUNT=5
CONFIG_BT_MESH_APP_KEY_COUNT=2
CONFIG_BT_MESH_MODEL_KEY_COUNT=2
CONFIG_BT_MESH_IV_UPDATE_TEST=y

CONFIG_BT_MESH_DEBUG=y
CONFIG_BT_SETTINGS=y
CONFIG_BT_MESH_MODEL_EXTENSIONS=y

# Bluetooth mesh model configuration
CONFIG_BT_MESH_SCENE_SRV=y
CONFIG_BT_MESH_TIME_SRV=y
CONFIG_BT_MESH_SCHEDULER_SRV=y
CONFIG_BT_MESH_SCHEDULER_CLI=y
CONFIG_BT_MESH_DEBUG_MODEL=y

CONFIG_BT_MESH_DEBUG_ADV=y
CONFIG_BT_MESH_DEBUG_NET=y
CONFIG_BT_MESH_DEBUG_TRANS=y
CONFIG_BT_MESH_DEBUG_ACCESS=y
```

## src/main.c
```c
/*
 * Copyright (c) 2021 Nordic Semiconductor
 *
 * SPDX-License-Identifier: Apache-2.0
 */

#include "bstests.h"
#include "mesh_test.h"

extern struct bst_test_list *
test_scheduler_model_install(struct bst_test_list *tests);

bst_test_install_t test_installers[] = {
	test_scheduler_model_install,
	NULL
};

void main(void)
{
	bst_main();
}
```

## src/mesh_test.c
```c
/*
 * Copyright (c) 2021 Nordic Semiconductor ASA
 *
 * SPDX-License-Identifier: Apache-2.0
 */
#include "mesh_test.h"

#define LOG_MODULE_NAME mesh_test

#include <logging/log.h>
LOG_MODULE_REGISTER(LOG_MODULE_NAME);

/* Max number of messages that can be pending on RX at the same time */
#define RECV_QUEUE_SIZE 32

const struct bt_mesh_test_cfg *cfg;

static void time_update_cb(struct bt_mesh_time_srv *srv,
			   struct bt_mesh_msg_ctx *ctx,
			   enum bt_mesh_time_update_types type)
{}

static struct bt_mesh_cfg_cli cfg_cli;

static struct bt_mesh_time_srv time_srv = BT_MESH_TIME_SRV_INIT(time_update_cb);
static struct bt_mesh_scheduler_srv scheduler_srv =
	BT_MESH_SCHEDULER_SRV_INIT(scheduler_action_set_cb, &time_srv);
static struct bt_mesh_scheduler_cli scheduler_cli;

static struct bt_mesh_elem elems[] = {
	BT_MESH_ELEM(0, BT_MESH_MODEL_LIST(
		BT_MESH_MODEL_CFG_SRV,
		BT_MESH_MODEL_CFG_CLI(&cfg_cli),
		BT_MESH_MODEL_SCHEDULER_SRV(&scheduler_srv),
		BT_MESH_MODEL_TIME_SRV(&time_srv),
		BT_MESH_MODEL_SCHEDULER_CLI(&scheduler_cli)),
	BT_MESH_MODEL_NONE),
};

static const struct bt_mesh_comp comp = {
	.elem = elems,
	.elem_count = ARRAY_SIZE(elems),
};

const uint8_t test_net_key[16] = { 1, 2, 3 };
const uint8_t test_app_key[16] = { 4, 5, 6 };
const uint8_t test_va_uuid[16] = "Mesh Label UUID";

static void bt_enabled(int err)
{
	static struct bt_mesh_prov prov;
	uint8_t status;

	if (err) {
		FAIL("Bluetooth init failed (err %d)\n", err);
		return;
	}

	LOG_INF("Bluetooth initialized");

	err = bt_mesh_init(&prov, &comp);
	if (err) {
		FAIL("Initializing mesh failed (err %d)", err);
		return;
	}

	if (IS_ENABLED(CONFIG_SETTINGS)) {
		settings_load();
	}

	err = bt_mesh_provision(test_net_key, 0, 0, 0, cfg->addr, cfg->dev_key);
	if (err) {
		FAIL("Provisioning failed (err %d)", err);
		return;
	}

	LOG_INF("Mesh initialized");

	/* Self configure */

	err = bt_mesh_cfg_app_key_add(0, cfg->addr, 0, 0, test_app_key,
				      &status);
	if (err || status) {
		FAIL("AppKey add failed (err %d, status %u)", err, status);
		return;
	}

	err = bt_mesh_cfg_net_transmit_set(0, cfg->addr,
					   BT_MESH_TRANSMIT(2, 20), &status);
	if (err || status != BT_MESH_TRANSMIT(2, 20)) {
		FAIL("Net transmit set failed (err %d, status %u)", err,
		     status);
		return;
	}

	/* Scheduler model configuration */
	err = bt_mesh_cfg_mod_app_bind(0, cfg->addr, cfg->addr, 0, BT_MESH_MODEL_ID_SCHEDULER_SRV,
				       &status);
	if (err || status) {
		FAIL("Mod app bind failed (err %d, status %u)", err, status);
		return;
	}

	err = bt_mesh_cfg_mod_app_bind(0, cfg->addr, cfg->addr, 0, BT_MESH_MODEL_ID_SCHEDULER_SETUP_SRV,
				       &status);
	if (err || status) {
		FAIL("Mod app bind failed (err %d, status %u)", err, status);
		return;
	}

	err = bt_mesh_cfg_mod_app_bind(0, cfg->addr, cfg->addr, 0, BT_MESH_MODEL_ID_SCHEDULER_CLI,
				       &status);
	if (err || status) {
		FAIL("Mod app bind failed (err %d, status %u)", err, status);
		return;
	}
}

void bt_mesh_test_setup(void)
{
	int err;

	err = bt_enable(bt_enabled);
	if (err) {
		FAIL("Bluetooth init failed (err %d)", err);
		return;
	}
}

void bt_mesh_test_timeout(bs_time_t HW_device_time)
{
	if (bst_result != Passed) {
		FAIL("Test timeout (not passed after %i seconds)",
		     HW_device_time / USEC_PER_SEC);
	}

	bs_trace_silent_exit(0);
}

void bt_mesh_test_cfg_set(const struct bt_mesh_test_cfg *my_cfg, int wait_time)
{
	bst_ticker_set_next_tick_absolute(wait_time * USEC_PER_SEC);
	bst_result = In_progress;
	cfg = my_cfg;
}
```

## src/mesh_test.h
```c
/** @file
 *  @brief Common functionality for Bluetooth Mesh BabbleSim tests.
 */

/*
 * Copyright (c) 2021 Nordic Semiconductor ASA
 *
 * SPDX-License-Identifier: Apache-2.0
 */
#ifndef ZEPHYR_TESTS_BLUETOOTH_BSIM_BT_BSIM_TEST_MESH_MESH_TEST_H_
#define ZEPHYR_TESTS_BLUETOOTH_BSIM_BT_BSIM_TEST_MESH_MESH_TEST_H_
#include "kernel.h"

#include "bs_types.h"
#include "bs_tracing.h"
#include "time_machine.h"
#include "bstests.h"

#include <zephyr/types.h>
#include <stddef.h>
#include <errno.h>
#include <zephyr.h>
#include <sys/printk.h>

#include <bluetooth/bluetooth.h>
#include <bluetooth/mesh.h>
#include <bluetooth/mesh/models.h>

#define FAIL(msg, ...)                                                         \
	do {                                                                   \
		bst_result = Failed;                                           \
		bs_trace_error_time_line(msg "\n", ##__VA_ARGS__);             \
	} while (0)

#define PASS()                                                                 \
	do {                                                                   \
		bst_result = Passed;                                           \
		bs_trace_info_time(1, "%s PASSED\n", __func__);                \
	} while (0)

#define ASSERT_OK(cond, ...)                                                   \
	do {                                                                   \
		int _err = (cond);                                             \
		if (_err) {                                                    \
			bst_result = Failed;                                   \
			bs_trace_error_time_line(                              \
				#cond " failed with error %d\n", _err);        \
		}                                                              \
	} while (0)

struct bt_mesh_test_cfg {
	uint16_t addr;
	uint8_t dev_key[16];
};

extern enum bst_result_t bst_result;
extern const uint8_t test_net_key[16];
extern const uint8_t test_app_key[16];
extern const uint8_t test_va_uuid[16];

void bt_mesh_test_cfg_set(const struct bt_mesh_test_cfg *cfg, int wait_time);
void bt_mesh_test_setup(void);
void bt_mesh_test_timeout(bs_time_t HW_device_time);

void scheduler_action_set_cb(struct bt_mesh_scheduler_srv *srv,
			     struct bt_mesh_msg_ctx *ctx,
			     uint8_t idx,
			     struct bt_mesh_schedule_entry *entry);
#endif /* ZEPHYR_TESTS_BLUETOOTH_BSIM_BT_BSIM_TEST_MESH_MESH_TEST_H_ */
```

## src/test_scheduler_model.c
```c
/*
 * Copyright (c) 2021 Nordic Semiconductor
 *
 * SPDX-License-Identifier: Apache-2.0
 */
#include <fs/fs.h>
#include <ff.h>
#include "mesh_test.h"
#include <bluetooth/mesh.h>
#include <bluetooth/mesh/models.h>

#define LOG_MODULE_NAME test_scheduler

#include <logging/log.h>
LOG_MODULE_REGISTER(LOG_MODULE_NAME);

#define WAIT_TIME 60 /*seconds*/
#define FATFS_MNTP   "/RAM:"

static FATFS fat_fs;
/* mounting info */
static struct fs_mount_t fatfs_mnt = {
	.type = FS_FATFS,
	.mnt_point = FATFS_MNTP,
	.fs_data = &fat_fs,
};

void scheduler_action_set_cb(struct bt_mesh_scheduler_srv *srv,
			     struct bt_mesh_msg_ctx *ctx,
			     uint8_t idx,
			     struct bt_mesh_schedule_entry *entry)
{
}

static const struct bt_mesh_test_cfg scheduler_srv_model_cfg = {
	.addr = 0x0001,
	.dev_key = { 0x01 },
};

static const struct bt_mesh_test_cfg scheduler_cli_model_cfg = {
	.addr = 0x0002,
	.dev_key = { 0x02 },
};

static void mount_settings_area(void)
{
	int err = fs_mount(&fatfs_mnt);
	LOG_INF("Mount point creation status: %i", err);
}

static void test_server_init(void)
{
	LOG_INF("%s", __func__);
}

static void test_client_init(void)
{
	LOG_INF("%s", __func__);
}

static void test_server_check_init(void)
{
	mount_settings_area();
	bt_mesh_test_cfg_set(&scheduler_srv_model_cfg, WAIT_TIME);
	bt_mesh_test_setup();

	k_sleep(K_SECONDS(5));

	PASS();
}

static void test_client_check_init(void)
{
	mount_settings_area();
	bt_mesh_test_cfg_set(&scheduler_cli_model_cfg, WAIT_TIME);
	bt_mesh_test_setup();

	k_sleep(K_SECONDS(5));

	PASS();
}

#define TEST_CASE(role, name, description)                                     \
	{                                                                      \
		.test_id = "scheduler_model_" #role "_" #name,                 \
		.test_descr = description,                                     \
		.test_post_init_f = test_##role##_init,                        \
		.test_tick_f = bt_mesh_test_timeout,                           \
		.test_main_f = test_##role##_##name,                           \
	}

static const struct bst_test_instance test_scheduler[] = {
	TEST_CASE(server, check_init,        "Initialization of the scheduler server model"),
	TEST_CASE(client, check_init,        "Initialization of the scheduler client model"),
	BSTEST_END_MARKER
};

struct bst_test_list *test_scheduler_model_install(struct bst_test_list *tests)
{
	return bst_add_tests(tests, test_scheduler);
}
```
