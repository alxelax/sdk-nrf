## tests/subsys/bluetooth/mesh/scheduler_srv_model/testcase.yaml
```yaml
tests:
  bluetooth.mesh.scheduler_srv_model:
    platform_allow: native_posix qemu_cortex_m3 
    tags: bluetooth mesh models ci_build
```
